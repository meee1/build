## configs/u1/fvp/defconfig
```kconfig
CONFIG_ARCH="arm"
CONFIG_ARCH_ARM_SONG=y
CONFIG_ARCH_BOARD="song/u1"
CONFIG_ARCH_BOARD_SONG=y
CONFIG_ARCH_BOARD_U1=y
CONFIG_ARCH_CHIP_FVP_MPS2_M4=y
CONFIG_ARCH_CHIP_SONG=y
CONFIG_ARCH_STACKDUMP=y
CONFIG_ARM_MPU=y
CONFIG_ARM_SEMIHOSTING_HOSTFS=y
CONFIG_ARMV7M_MEMCPY=y
CONFIG_ARMV7M_SYSTICK=y
CONFIG_ARMV7M_USEBASEPRI=y
CONFIG_BOARDCTL_FINALINIT=y
CONFIG_BUILTIN=y
CONFIG_CLOCK_MONOTONIC=y
CONFIG_CMSDK_UART0_BASE=0x40004000
CONFIG_CMSDK_UART0_CLOCK=25000000
CONFIG_CMSDK_UART0_OV_IRQ=28
CONFIG_CMSDK_UART0_RX_IRQ=16
CONFIG_CMSDK_UART0_SERIAL_CONSOLE=y
CONFIG_CMSDK_UART0_TX_IRQ=17
CONFIG_CMSDK_UART0=y
CONFIG_CMSDK_UART1_BASE=0x40005000
CONFIG_CMSDK_UART1_CLOCK=25000000
CONFIG_CMSDK_UART1_OV_IRQ=28
CONFIG_CMSDK_UART1_RX_IRQ=18
CONFIG_CMSDK_UART1_TX_IRQ=19
CONFIG_CMSDK_UART1=y
CONFIG_CMSDK_UART=y
CONFIG_CMSIS=y
CONFIG_DEBUG_HARDFAULT_ALERT=y
CONFIG_DEBUG_MEMFAULT=y
CONFIG_DEBUG_SYMBOLS=y
CONFIG_FS_HOSTFS=y
CONFIG_FS_PROCFS=y
CONFIG_FS_ROMFS=y
CONFIG_HEAP_COLORATION=y
CONFIG_IDLETHREAD_STACKSIZE=2048
CONFIG_IRQCHAIN=y
CONFIG_MEMSET_OPTSPEED=y
CONFIG_NBIOT_HLS_FVP=y
CONFIG_NBIOT_MODEM=y
CONFIG_NET_ARP_IPIN=y
CONFIG_NET_ARP_SEND=y
CONFIG_NET_BROADCAST=y
CONFIG_NETDB_DNSCLIENT_MAXRESPONSE=176
CONFIG_NETDB_DNSCLIENT_RECV_TIMEOUT=3
CONFIG_NETDB_DNSCLIENT=y
CONFIG_NETDEVICES=y
CONFIG_NETDEV_STATISTICS=y
CONFIG_NET_ICMP_SOCKET=y
CONFIG_NET_ICMPv6_AUTOCONF=y
CONFIG_NET_ICMPv6_NEIGHBOR=y
CONFIG_NET_ICMPv6_SOCKET=y
CONFIG_NET_ICMPv6=y
CONFIG_NET_ICMP=y
CONFIG_NET_IPv6=y
CONFIG_NET_LAN91C111=y
CONFIG_NET_LOOPBACK=y
CONFIG_NET_SOCKOPTS=y
CONFIG_NET_SOLINGER=y
CONFIG_NET_STATISTICS=y
CONFIG_NET_TCPBACKLOG=y
CONFIG_NET_TCP_WRITE_BUFFERS=y
CONFIG_NET_TCP=y
CONFIG_NET_UDP_BINDTODEVICE=y
CONFIG_NET_UDP_WRITE_BUFFERS=y
CONFIG_NET_UDP=y
CONFIG_NETUTILS_DHCPC=y
CONFIG_NET=y
CONFIG_NSH_ARCHINIT=y
CONFIG_NSH_ARCHROMFS=y
CONFIG_NSH_BUILTIN_APPS=y
CONFIG_NSH_DHCPC=y
CONFIG_NSH_LINELEN=128
CONFIG_NSH_NETINIT_THREAD=y
CONFIG_NSH_PROMPT_STRING="fvp> "
CONFIG_NSH_READLINE=y
CONFIG_NSH_ROMFSETC=y
CONFIG_PSEUDOFS_SOFTLINKS=y
CONFIG_PSEUDOTERM_BSD=y
CONFIG_PSEUDOTERM=y
CONFIG_RAW_BINARY=y
CONFIG_READLINE_CMD_HISTORY=y
CONFIG_READLINE_TABCOMPLETION=y
CONFIG_SCHED_CHILD_STATUS=y
CONFIG_SCHED_HAVE_PARENT=y
CONFIG_SCHED_HPWORK=y
CONFIG_SCHED_IRQMONITOR=y
CONFIG_SERIAL_TERMIOS=y
CONFIG_SIG_DEFAULT=y
CONFIG_SONG_NR_IRQS=48
CONFIG_STACK_COLORATION=y
CONFIG_SYSLOG_BUFFER=y
CONFIG_SYSLOG_CHARDEV=y
CONFIG_SYSLOG_INTBUFFER=y
CONFIG_SYSLOG_PREFIX_STRING="fvp: "
CONFIG_SYSLOG_PREFIX=y
CONFIG_SYSLOG_TIMESTAMP=y
CONFIG_SYSTEM_CLE=y
CONFIG_SYSTEM_NSH=y
CONFIG_SYSTEM_PING6=y
CONFIG_SYSTEM_PING=y
CONFIG_SYSTEM_SYSTEM=y
CONFIG_SYSTEM_TIME64=y
CONFIG_TIMER_ARCH=y
CONFIG_TIMER_CMSDK=y
CONFIG_TIMER=y
CONFIG_TTY_SIGINT=y
CONFIG_U1_FVP=y
CONFIG_USER_ENTRYPOINT="nsh_main"
```

## configs/u1/sim/defconfig
```kconfig
CONFIG_ARCH_BOARD="song/u1"
CONFIG_ARCH_BOARD_SONG=y
CONFIG_ARCH="sim"
CONFIG_ARCH_SIM=y
CONFIG_BOARDCTL_POWEROFF=y
CONFIG_BOARD_INITIALIZE=y
CONFIG_BOARD_INITTHREAD=y
CONFIG_BUILTIN=y
CONFIG_CLOCK_MONOTONIC=y
CONFIG_DEBUG_FEATURES=y
CONFIG_DEBUG_SYMBOLS=y
# CONFIG_DEV_NULL is not set
CONFIG_EXAMPLES_NSH=y
CONFIG_FS_HOSTFS=y
CONFIG_FS_PROCFS=y
CONFIG_FS_ROMFS=y
CONFIG_LIB_BOARDCTL=y
CONFIG_MEMSET_OPTSPEED=y
CONFIG_NET_ARP_IPIN=y
CONFIG_NET_ARP_SEND=y
CONFIG_NET_BROADCAST=y
CONFIG_NETDB_DNSCLIENT_MAXRESPONSE=176
CONFIG_NETDB_DNSCLIENT=y
CONFIG_NETDEVICES=y
CONFIG_NET_ICMP_SOCKET=y
CONFIG_NET_ICMP=y
CONFIG_NET_LOOPBACK=y
CONFIG_NET_SOCKOPTS=y
CONFIG_NET_TCP_WRITE_BUFFERS=y
CONFIG_NET_TCP=y
CONFIG_NET_UDP=y
CONFIG_NETUTILS_DHCPC=y
CONFIG_NET=y
CONFIG_NSH_ARCHROMFS=y
CONFIG_NSH_BUILTIN_APPS=y
CONFIG_NSH_DHCPC=y
CONFIG_NSH_DNS=y
CONFIG_NSH_LINELEN=128
CONFIG_NSH_NETINIT_THREAD=y
CONFIG_NSH_PROMPT_STRING="sim> "
CONFIG_NSH_READLINE=y
CONFIG_NSH_ROMFSETC=y
CONFIG_READLINE_CMD_HISTORY=y
CONFIG_READLINE_TABCOMPLETION=y
CONFIG_SCHED_CHILD_STATUS=y
CONFIG_SCHED_HAVE_PARENT=y
CONFIG_SCHED_HPWORK=y
CONFIG_SCHED_WAITPID=y
CONFIG_SIM_M32=y
CONFIG_SIM_NET_BRIDGE=y
CONFIG_SIM_WALLTIME=y
CONFIG_SYSLOG_PREFIX_STRING="sim: "
CONFIG_SYSLOG_PREFIX=y
CONFIG_SYSLOG_TIMESTAMP=y
CONFIG_SYSTEM_CLE=y
CONFIG_SYSTEM_PING=y
CONFIG_SYSTEM_TIME64=y
CONFIG_U1_SIM=y
CONFIG_USER_ENTRYPOINT="nsh_main"
```

## configs/u1/sp/defconfig
```kconfig
CONFIG_ALARM_ARCH=y
CONFIG_ARCH="arm"
CONFIG_ARCH_ARM_SONG=y
CONFIG_ARCH_BOARD="song/u1"
CONFIG_ARCH_BOARD_SONG=y
CONFIG_ARCH_BOARD_U1=y
CONFIG_ARCH_CHIP_SONG=y
CONFIG_ARCH_CHIP_U1_SP=y
CONFIG_ARCH_RAMVECTORS=y
CONFIG_ARCH_STACKDUMP=y
CONFIG_ARM_MPU=y
CONFIG_ARMV7M_MEMCPY=y
CONFIG_ARMV7M_SYSTICK=y
CONFIG_ARMV7M_USEBASEPRI=y
CONFIG_BOARDCTL_FINALINIT=y
CONFIG_BOARDCTL_RESET=y
CONFIG_BOARD_RESET_ON_ASSERT=2
CONFIG_BUILTIN=y
CONFIG_CLK_RPMSG=y
CONFIG_CLK=y
CONFIG_CLOCK_MONOTONIC=y
CONFIG_DEBUG_FULLOPT=y
CONFIG_DEBUG_HARDFAULT_ALERT=y
CONFIG_DEBUG_MEMFAULT=y
CONFIG_DEBUG_SYMBOLS=y
# CONFIG_DEV_NULL is not set
CONFIG_DMA=y
CONFIG_FS_HOSTFS_RPMSG_SERVER=y
CONFIG_FS_LITTLEFS=y
CONFIG_FS_PROCFS=y
CONFIG_FS_ROMFS=y
CONFIG_GD25_SPIFREQUENCY=5000000
CONFIG_HEAP_COLORATION=y
CONFIG_IOEXPANDER_MULTIPIN=y
CONFIG_IOEXPANDER_NPINS=48
CONFIG_IOEXPANDER=y
CONFIG_IRQCHAIN=y
CONFIG_MBOX=y
CONFIG_MEMSET_OPTSPEED=y
CONFIG_MTD_BYTE_WRITE=y
CONFIG_MTD_GD25=y
CONFIG_MTD_PARTITION_NAMES=y
CONFIG_MTD_PARTITION=y
CONFIG_MTD=y
CONFIG_NET_BROADCAST=y
CONFIG_NETDB_DNSCLIENT_MAXRESPONSE=176
CONFIG_NETDB_DNSCLIENT_RECV_TIMEOUT=3
CONFIG_NETDB_DNSCLIENT=y
CONFIG_NETDEVICES=y
CONFIG_NETDEV_STATISTICS=y
# CONFIG_NET_ETHERNET is not set
CONFIG_NET_ICMP_SOCKET=y
CONFIG_NET_ICMPv6_SOCKET=y
CONFIG_NET_ICMPv6=y
CONFIG_NET_ICMP=y
CONFIG_NET_IPv6=y
CONFIG_NET_LOOPBACK=y
CONFIG_NET_RPMSG_DRV=y
CONFIG_NET_SLIP_PKTSIZE=1500
CONFIG_NET_SLIP=y
CONFIG_NET_SOCKOPTS=y
CONFIG_NET_SOLINGER=y
CONFIG_NET_STATISTICS=y
CONFIG_NET_TCPBACKLOG=y
CONFIG_NET_TCP_WRITE_BUFFERS=y
CONFIG_NET_TCP=y
CONFIG_NET_UDP_BINDTODEVICE=y
CONFIG_NET_UDP_WRITE_BUFFERS=y
CONFIG_NET_UDP=y
CONFIG_NET=y
CONFIG_NSH_ARCHINIT=y
CONFIG_NSH_ARCHROMFS=y
CONFIG_NSH_BUILTIN_APPS=y
CONFIG_NSH_LINELEN=128
CONFIG_NSH_NETINIT_THREAD=y
CONFIG_NSH_NOMAC=y
CONFIG_NSH_PROMPT_STRING="sp> "
CONFIG_NSH_READLINE=y
CONFIG_NSH_ROMFSETC=y
CONFIG_ONESHOT_SONG=y
CONFIG_ONESHOT=y
CONFIG_OPENAMP=y
CONFIG_PM=y
CONFIG_PSEUDOFS_SOFTLINKS=y
CONFIG_PTABLE_PARTITION=y
CONFIG_RAW_BINARY=y
CONFIG_READLINE_CMD_HISTORY=y
CONFIG_READLINE_TABCOMPLETION=y
CONFIG_REGULATOR=y
CONFIG_RPMSG_REGULATOR=y
CONFIG_RPMSG_UART=y
CONFIG_RPMSG_USRSOCK=y
CONFIG_RPTUN=y
CONFIG_RTC_ALARM=y
CONFIG_RTC_ARCH=y
CONFIG_RTC_DATETIME=y
CONFIG_RTC_DRIVER=y
CONFIG_RTC_EXTERNAL=y
CONFIG_RTC_SONG=y
CONFIG_RTC=y
CONFIG_SCHED_CHILD_STATUS=y
CONFIG_SCHED_HAVE_PARENT=y
CONFIG_SCHED_HPWORK=y
CONFIG_SCHED_IRQMONITOR=y
CONFIG_SCHED_TICKLESS_ALARM=y
CONFIG_SCHED_TICKLESS_LIMIT_MAX_SLEEP=y
CONFIG_SCHED_TICKLESS=y
CONFIG_SCHED_WAITPID=y
CONFIG_SERIAL_IFLOWCONTROL_WATERMARKS=y
CONFIG_SERIAL_TERMIOS=y
CONFIG_SIG_DEFAULT=y
CONFIG_SONG_CLK=y
CONFIG_SONG_DMAS=y
CONFIG_SONG_ICACHE_BASE=0xb01500d0
CONFIG_SONG_IOE=y
CONFIG_SONG_MBOX=y
CONFIG_SONG_NR_IRQS=37
CONFIG_SONG_ONCHIP_FLASH=y
CONFIG_SONG_PMIC_APB=y
CONFIG_SONG_RNG_BASE=0xb0150000
CONFIG_SONG_RNG=y
CONFIG_SONG_RPTUN=y
CONFIG_SPI_DRIVER=y
CONFIG_SPI_DW=y
CONFIG_STACK_COLORATION=y
CONFIG_SYSLOG_BUFFER=y
CONFIG_SYSLOG_PREFIX_STRING="sp: "
CONFIG_SYSLOG_PREFIX=y
CONFIG_SYSLOG_RPMSG=y
CONFIG_SYSLOG_TIMESTAMP=y
CONFIG_SYSTEM_CLE=y
CONFIG_SYSTEM_NSH=y
CONFIG_SYSTEM_PING6=y
CONFIG_SYSTEM_PING=y
CONFIG_SYSTEM_TIME64=y
CONFIG_TIMER=y
CONFIG_TTY_SIGINT=y
CONFIG_U1_SP=y
CONFIG_USER_ENTRYPOINT="nsh_main"
CONFIG_WATCHDOG_DW=y
CONFIG_WATCHDOG=y
```

## configs/u2/Kconfig
```kconfig
#
# For a description of the syntax of this configuration file,
# see the file kconfig-language.txt in the NuttX tools repository.
#

choice
	prompt "Select target application"

config U2_AP
	bool "U2 AP"

endchoice
```

## configs/u2/ap/defconfig
```kconfig
CONFIG_16550_ADDRWIDTH=32
CONFIG_16550_REGWIDTH=32
CONFIG_16550_SUPRESS_INITIAL_CONFIG=y
CONFIG_16550_UART0_BASE=0xa0150000
CONFIG_16550_UART0_CLOCK=1843200
CONFIG_16550_UART0_IRQ=24
CONFIG_16550_UART0_SERIAL_CONSOLE=y
CONFIG_16550_UART0=y
CONFIG_16550_UART=y
CONFIG_ALARM_ARCH=y
CONFIG_ARCH="arm"
CONFIG_ARCH_ARM_SONG=y
CONFIG_ARCH_BOARD="song/u2"
CONFIG_ARCH_BOARD_SONG=y
CONFIG_ARCH_BOARD_U2=y
CONFIG_ARCH_CHIP_SONG=y
CONFIG_ARCH_CHIP_U2_AP=y
CONFIG_ARCH_STACKDUMP=y
CONFIG_ARM_MPU=y
CONFIG_ARMV7M_MEMCPY=y
CONFIG_ARMV7M_SYSTICK=y
CONFIG_ARMV7M_USEBASEPRI=y
CONFIG_BOARD_INITIALIZE=y
CONFIG_BOARD_INITTHREAD=y
CONFIG_BOOT_RUNFROMISRAM=y
CONFIG_BUILTIN=y
CONFIG_CLOCK_MONOTONIC=y
CONFIG_DEBUG_FEATURES=y
CONFIG_DEBUG_HARDFAULT=y
# CONFIG_DEV_NULL is not set
CONFIG_EXAMPLES_NSH=y
CONFIG_FS_HOSTFS_RPMSG_SERVER=y
CONFIG_FS_PROCFS=y
CONFIG_FS_ROMFS=y
CONFIG_HEAP_COLORATION=y
CONFIG_MBOX=y
CONFIG_MEMSET_OPTSPEED=y
CONFIG_NSH_ARCHROMFS=y
CONFIG_NSH_BUILTIN_APPS=y
CONFIG_NSH_LINELEN=128
CONFIG_NSH_PROMPT_STRING="ap> "
CONFIG_NSH_READLINE=y
CONFIG_NSH_ROMFSETC=y
CONFIG_ONESHOT_SONG=y
CONFIG_ONESHOT=y
CONFIG_OPENAMP=y
CONFIG_RAW_BINARY=y
CONFIG_READLINE_CMD_HISTORY=y
CONFIG_READLINE_TABCOMPLETION=y
CONFIG_RPMSG_UART=y
CONFIG_RPTUN=y
CONFIG_SCHED_CHILD_STATUS=y
CONFIG_SCHED_HAVE_PARENT=y
CONFIG_SCHED_HPWORK=y
CONFIG_SCHED_TICKLESS_ALARM=y
CONFIG_SCHED_TICKLESS_LIMIT_MAX_SLEEP=y
CONFIG_SCHED_TICKLESS=y
CONFIG_SCHED_WAITPID=y
CONFIG_SERIAL_IFLOWCONTROL_WATERMARKS=y
CONFIG_SERIAL_UART_ARCH_MMIO=y
CONFIG_SIG_SIGKILL=y
CONFIG_SONG_MBOX=y
CONFIG_SONG_NR_IRQS=38
CONFIG_SONG_RPTUN=y
CONFIG_STACK_COLORATION=y
CONFIG_SYSLOG_PREFIX_STRING="ap: "
CONFIG_SYSLOG_PREFIX=y
CONFIG_SYSLOG_RPMSG_SERVER=y
CONFIG_SYSLOG_TIMESTAMP=y
CONFIG_SYSTEM_CLE=y
CONFIG_SYSTEM_CUTERM_DEFAULT_DEVICE="/dev/ttyADSP"
CONFIG_SYSTEM_CUTERM_PRIORITY=200
CONFIG_SYSTEM_CUTERM=y
CONFIG_SYSTEM_TIME64=y
CONFIG_TIMER=y
CONFIG_USER_ENTRYPOINT="nsh_main"
```

## configs/u2/audio/defconfig
```kconfig
CONFIG_ALARM_ARCH=y
CONFIG_ARCH_BOARD="song/u2"
CONFIG_ARCH_BOARD_SONG=y
CONFIG_ARCH_BOARD_U2=y
CONFIG_ARCH_CHIP_SONG=y
CONFIG_ARCH_CHIP_U2_AUDIO=y
CONFIG_ARCH_HIPRI_INTERRUPT=y
CONFIG_ARCH="risc-v"
CONFIG_ARCH_RISCV_SONG=y
CONFIG_ARCH_RISCV=y
CONFIG_ARCH_STACKDUMP=y
CONFIG_BOARDCTL_FINALINIT=y
CONFIG_BOARDCTL_RESET=y
CONFIG_BOOT_RUNFROMISRAM=y
CONFIG_BUILTIN=y
CONFIG_CLK_RPMSG=y
CONFIG_CLK=y
CONFIG_CLOCK_MONOTONIC=y
# CONFIG_DEV_NULL is not set
CONFIG_DMA=y
CONFIG_FS_PROCFS=y
CONFIG_FS_ROMFS=y
CONFIG_INTC_DW_BASE=0xa0010000
CONFIG_IRQCHAIN=y
CONFIG_MBOX=y
CONFIG_MEMSET_OPTSPEED=y
CONFIG_NSH_ARCHINIT=y
CONFIG_NSH_ARCHROMFS=y
CONFIG_NSH_BUILTIN_APPS=y
CONFIG_NSH_LINELEN=128
CONFIG_NSH_PROMPT_STRING="audio> "
CONFIG_NSH_READLINE=y
CONFIG_NSH_ROMFSETC=y
CONFIG_ONESHOT_SONG=y
CONFIG_ONESHOT=y
CONFIG_OPENAMP=y
CONFIG_PM=y
CONFIG_RAW_BINARY=y
CONFIG_READLINE_CMD_HISTORY=y
CONFIG_READLINE_TABCOMPLETION=y
CONFIG_RPMSG_UART=y
CONFIG_RPTUN=y
CONFIG_RV32IM_HW_MULDIV=y
CONFIG_SCHED_CHILD_STATUS=y
CONFIG_SCHED_HAVE_PARENT=y
CONFIG_SCHED_HPWORK=y
CONFIG_SCHED_IRQMONITOR=y
CONFIG_SCHED_TICKLESS_ALARM=y
CONFIG_SCHED_TICKLESS_LIMIT_MAX_SLEEP=y
CONFIG_SCHED_TICKLESS=y
CONFIG_SCHED_WAITPID=y
CONFIG_SERIAL_IFLOWCONTROL_WATERMARKS=y
CONFIG_SERIAL_TERMIOS=y
CONFIG_SIG_DEFAULT=y
CONFIG_SONG_CLK=y
CONFIG_SONG_DMAG=y
CONFIG_SONG_DMAS=y
CONFIG_SONG_MBOX=y
CONFIG_SONG_NR_IRQS=24
CONFIG_SONG_RPTUN=y
CONFIG_SYSLOG_BUFFER=y
CONFIG_SYSLOG_CHARDEV=y
CONFIG_SYSLOG_PREFIX_STRING="audio: "
CONFIG_SYSLOG_PREFIX=y
CONFIG_SYSLOG_RPMSG=y
CONFIG_SYSLOG_TIMESTAMP=y
CONFIG_SYSTEM_CLE=y
CONFIG_SYSTEM_NSH=y
CONFIG_SYSTEM_TIME64=y
CONFIG_SYSTEM_ZMODEM_MOUNTPOINT="/data"
CONFIG_SYSTEM_ZMODEM=y
CONFIG_TTY_SIGINT=y
CONFIG_U2_AUDIO=y
CONFIG_USER_ENTRYPOINT="nsh_main"
```

## configs/u2/audio/palladium_defconfig
```kconfig
CONFIG_16550_ADDRWIDTH=32
CONFIG_16550_REGWIDTH=32
CONFIG_16550_SUPRESS_INITIAL_CONFIG=y
CONFIG_16550_UART0_BASE=0xb2000000
CONFIG_16550_UART0_BAUD=9600
CONFIG_16550_UART0_CLOCK=153600
CONFIG_16550_UART0_DMA_RX=8
CONFIG_16550_UART0_DMA_TX=0
CONFIG_16550_UART0_DMA=y
CONFIG_16550_UART0_IRQ=17
CONFIG_16550_UART0=y
CONFIG_16550_UART1_BASE=0xb00b0000
CONFIG_16550_UART1_BAUD=921600
CONFIG_16550_UART1_CLOCK=14745600
CONFIG_16550_UART1_DMA_RX=9
CONFIG_16550_UART1_DMA_TX=1
CONFIG_16550_UART1_DMA=y
CONFIG_16550_UART1_IRQ=22
CONFIG_16550_UART1_RXBUFSIZE=1024
CONFIG_16550_UART1_SERIAL_CONSOLE=y
CONFIG_16550_UART1=y
CONFIG_16550_UART=y
CONFIG_ALARM_ARCH=y
CONFIG_ARCH="arm"
CONFIG_ARCH_ARM_SONG=y
CONFIG_ARCH_BOARD="song/u1"
CONFIG_ARCH_BOARD_SONG=y
CONFIG_ARCH_CHIP_SONG=y
CONFIG_ARCH_CHIP_U1_SP=y
CONFIG_ARCH_RAMVECTORS=y
CONFIG_ARCH_STACKDUMP=y
CONFIG_ARM_MPU=y
CONFIG_ARMV7M_MEMCPY=y
CONFIG_ARMV7M_SYSTICK=y
CONFIG_ARMV7M_USEBASEPRI=y
CONFIG_BOARDCTL_POWEROFF=y
CONFIG_BOARDCTL_RESET=y
CONFIG_BOARD_INITIALIZE=y
CONFIG_BOARD_INITTHREAD=y
CONFIG_BUILTIN=y
CONFIG_CLK_RPMSG=y
CONFIG_CLK=y
CONFIG_CLOCK_MONOTONIC=y
CONFIG_DEBUG_FEATURES=y
CONFIG_DEBUG_HARDFAULT=y
# CONFIG_DEV_NULL is not set
CONFIG_DMA=y
CONFIG_EXAMPLES_NSH=y
CONFIG_FS_HOSTFS_RPMSG_SERVER=y
CONFIG_FS_LITTLEFS=y
CONFIG_FS_PROCFS=y
CONFIG_FS_ROMFS=y
CONFIG_HEAP_COLORATION=y
CONFIG_IOEXPANDER_MULTIPIN=y
CONFIG_IOEXPANDER_NPINS=48
CONFIG_IOEXPANDER=y
CONFIG_IRQCHAIN=y
CONFIG_MBOX=y
CONFIG_MEMSET_OPTSPEED=y
CONFIG_MTD_BYTE_WRITE=y
CONFIG_MTD_PARTITION_NAMES=y
CONFIG_MTD_PARTITION=y
CONFIG_MTD=y
CONFIG_NET_BROADCAST=y
CONFIG_NETDB_DNSCLIENT_MAXRESPONSE=176
CONFIG_NETDB_DNSCLIENT=y
CONFIG_NETDEVICES=y
CONFIG_NETDEV_STATISTICS=y
# CONFIG_NET_ETHERNET is not set
CONFIG_NET_ICMP_SOCKET=y
CONFIG_NET_ICMP=y
CONFIG_NET_LOOPBACK=y
CONFIG_NET_RPMSG_DRV=y
CONFIG_NET_SLIP_MTU=1500
CONFIG_NET_SLIP_TCP_RECVWNDO=1460
CONFIG_NET_SLIP=y
CONFIG_NET_SOCKOPTS=y
CONFIG_NET_STATISTICS=y
CONFIG_NET_TCP_WRITE_BUFFERS=y
CONFIG_NET_TCP=y
CONFIG_NET_UDP=y
CONFIG_NET=y
CONFIG_NSH_ARCHINIT=y
CONFIG_NSH_ARCHROMFS=y
CONFIG_NSH_BUILTIN_APPS=y
CONFIG_NSH_LINELEN=128
CONFIG_NSH_NETINIT_THREAD=y
CONFIG_NSH_NOMAC=y
CONFIG_NSH_PROMPT_STRING="sp> "
CONFIG_NSH_READLINE=y
CONFIG_NSH_ROMFSETC=y
CONFIG_ONESHOT_SONG=y
CONFIG_ONESHOT=y
CONFIG_OPENAMP=y
CONFIG_PM=y
CONFIG_PTABLE_PARTITION=y
CONFIG_PWM_SONG=y
CONFIG_PWM=y
CONFIG_RAW_BINARY=y
CONFIG_READLINE_CMD_HISTORY=y
CONFIG_READLINE_TABCOMPLETION=y
CONFIG_REGULATOR=y
CONFIG_RPMSG_REGULATOR=y
CONFIG_RPMSG_UART=y
CONFIG_RPMSG_USRSOCK=y
CONFIG_RPTUN=y
CONFIG_RTC_ALARM=y
CONFIG_RTC_ARCH=y
CONFIG_RTC_DATETIME=y
CONFIG_RTC_DRIVER=y
CONFIG_RTC_SONG=y
CONFIG_RTC=y
CONFIG_SCHED_CHILD_STATUS=y
CONFIG_SCHED_HAVE_PARENT=y
CONFIG_SCHED_HPWORK=y
CONFIG_SCHED_IRQMONITOR=y
CONFIG_SCHED_TICKLESS_ALARM=y
CONFIG_SCHED_TICKLESS_LIMIT_MAX_SLEEP=y
CONFIG_SCHED_TICKLESS=y
CONFIG_SCHED_WAITPID=y
CONFIG_SERIAL_IFLOWCONTROL_WATERMARKS=y
CONFIG_SERIAL_TERMIOS=y
CONFIG_SERIAL_UART_ARCH_MMIO=y
CONFIG_SERVICES_ATCMD=y
CONFIG_SIG_SIGKILL=y
CONFIG_SONG_CLK=y
CONFIG_SONG_DMAS=y
CONFIG_SONG_ICACHE_BASE=0xb01500d0
CONFIG_SONG_IOE=y
CONFIG_SONG_MBOX=y
CONFIG_SONG_NR_IRQS=37
CONFIG_SONG_ONCHIP_FLASH=y
CONFIG_SONG_PMIC_APB=y
CONFIG_SONG_RNG_BASE=0xb0150000
CONFIG_SONG_RNG=y
CONFIG_SONG_RPTUN=y
CONFIG_SPI_DRIVER=y
CONFIG_SPI_DW=y
CONFIG_SPI=y
CONFIG_STACK_COLORATION=y
CONFIG_SYSLOG_BUFFER=y
CONFIG_SYSLOG_PREFIX_STRING="sp: "
CONFIG_SYSLOG_PREFIX=y
CONFIG_SYSLOG_RPMSG_SERVER=y
CONFIG_SYSLOG_TIMESTAMP=y
CONFIG_SYSTEM_CLE=y
CONFIG_SYSTEM_CUTERM_DEFAULT_DEVICE="/dev/ttyCP"
CONFIG_SYSTEM_CUTERM_PRIORITY=200
CONFIG_SYSTEM_CUTERM=y
CONFIG_SYSTEM_PING=y
CONFIG_SYSTEM_TIME64=y
CONFIG_SYSTEM_ZMODEM_MOUNTPOINT="/data"
CONFIG_SYSTEM_ZMODEM=y
CONFIG_TIMER=y
CONFIG_U1_SP=y
CONFIG_USER_ENTRYPOINT="nsh_main"
CONFIG_WATCHDOG_DW=y
CONFIG_WATCHDOG=y
```
