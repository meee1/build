## configs/u2/ck/defconfig
```kconfig
CONFIG_16550_ADDRWIDTH=32
CONFIG_16550_REGWIDTH=32
CONFIG_16550_SERIAL_DISABLE_REORDERING=y
CONFIG_16550_UART0_BASE=0xa0150000
CONFIG_16550_UART0_BAUD=921600
CONFIG_16550_UART0_CLOCK=14745600
CONFIG_16550_UART0_IRQ=8
CONFIG_16550_UART0_RXBUFSIZE=512
CONFIG_16550_UART0_SERIAL_CONSOLE=y
CONFIG_16550_UART0=y
CONFIG_16550_UART=y
CONFIG_ALARM_ARCH=y
CONFIG_ARCH_BOARD="song/u2"
CONFIG_ARCH_BOARD_SONG=y
CONFIG_ARCH_BOARD_U2=y
CONFIG_ARCH_CHIP_SONG=y
CONFIG_ARCH_CHIP_U2_CK=y
CONFIG_ARCH="csky"
CONFIG_ARCH_CSKY_SONG=y
CONFIG_ARCH_CSKY=y
CONFIG_ARCH_INTERRUPTSTACK=2048
CONFIG_ARCH_STACKDUMP=y
CONFIG_BOARDCTL_FINALINIT=y
CONFIG_BOARDCTL_RESET=y
CONFIG_BOARD_RESET_ON_ASSERT=2
CONFIG_BOOT_RUNFROMISRAM=y
CONFIG_BUILTIN=y
CONFIG_CLOCK_MONOTONIC=y
CONFIG_DEBUG_FULLOPT=y
CONFIG_DEBUG_SYMBOLS=y
# CONFIG_FS_PROCFS_EXCLUDE_ENVIRON is not set
CONFIG_FS_PROCFS=y
CONFIG_FS_ROMFS=y
CONFIG_HOSTNAME="ck"
CONFIG_IDLETHREAD_STACKSIZE=2048
CONFIG_IRQCHAIN=y
CONFIG_MEMSET_OPTSPEED=y
CONFIG_NSH_ARCHINIT=y
CONFIG_NSH_ARCHROMFS=y
CONFIG_NSH_BUILTIN_APPS=y
CONFIG_NSH_LINELEN=128
CONFIG_NSH_PROMPT_STRING="ck> "
CONFIG_NSH_READLINE=y
CONFIG_NSH_ROMFSETC=y
CONFIG_ONESHOT_SONG=y
CONFIG_ONESHOT=y
CONFIG_PSEUDOFS_SOFTLINKS=y
CONFIG_PSEUDOTERM_BSD=y
CONFIG_PSEUDOTERM=y
CONFIG_PTHREAD_CLEANUP_STACKSIZE=2
CONFIG_PTHREAD_CLEANUP=y
CONFIG_RAW_BINARY=y
CONFIG_READLINE_CMD_HISTORY=y
CONFIG_READLINE_TABCOMPLETION=y
CONFIG_SCHED_CHILD_STATUS=y
CONFIG_SCHED_HAVE_PARENT=y
CONFIG_SCHED_HPWORK=y
CONFIG_SCHED_IRQMONITOR=y
CONFIG_SCHED_TICKLESS_ALARM=y
CONFIG_SCHED_TICKLESS_LIMIT_MAX_SLEEP=y
CONFIG_SCHED_TICKLESS=y
CONFIG_SERIAL_TERMIOS=y
CONFIG_SERIAL_UART_ARCH_MMIO=y
CONFIG_SIG_DEFAULT=y
CONFIG_SIG_EVTHREAD=y
CONFIG_STACK_COLORATION=y
CONFIG_SYSLOG_BUFFER=y
CONFIG_SYSLOG_CHARDEV=y
CONFIG_SYSLOG_INTBUFFER=y
CONFIG_SYSLOG_PREFIX_STRING="ck: "
CONFIG_SYSLOG_PREFIX=y
CONFIG_SYSLOG_TIMESTAMP=y
CONFIG_SYSTEM_CLE=y
CONFIG_SYSTEM_NSH=y
CONFIG_SYSTEM_SYSTEM=y
CONFIG_SYSTEM_TIME64=y
CONFIG_TIMER=y
CONFIG_TTY_SIGINT=y
CONFIG_USER_ENTRYPOINT="nsh_main"
```

## configs/u2/ri5cy/defconfig
```kconfig
CONFIG_16550_ADDRWIDTH=32
CONFIG_16550_REGWIDTH=32
CONFIG_16550_SERIAL_DISABLE_REORDERING=y
CONFIG_16550_UART0_BASE=0xa0150000
CONFIG_16550_UART0_BAUD=921600
CONFIG_16550_UART0_CLOCK=14745600
CONFIG_16550_UART0_IRQ=8
CONFIG_16550_UART0_RXBUFSIZE=512
CONFIG_16550_UART0_SERIAL_CONSOLE=y
CONFIG_16550_UART0=y
CONFIG_16550_UART1_BASE=0xa0160000
CONFIG_16550_UART1_CLOCK=1843200
CONFIG_16550_UART1_IRQ=15
CONFIG_16550_UART1=y
CONFIG_16550_UART=y
CONFIG_ALARM_ARCH=y
CONFIG_ARCH_BOARD="song/u2"
CONFIG_ARCH_BOARD_SONG=y
CONFIG_ARCH_BOARD_U2=y
CONFIG_ARCH_CHIP_SONG=y
CONFIG_ARCH_CHIP_U2_RI5CY=y
CONFIG_ARCH_HIPRI_INTERRUPT=y
CONFIG_ARCH="risc-v"
CONFIG_ARCH_RISCV_SONG=y
CONFIG_ARCH_RISCV=y
CONFIG_ARCH_STACKDUMP=y
CONFIG_BOOT_RUNFROMISRAM=y
CONFIG_BUILTIN=y
CONFIG_CLOCK_MONOTONIC=y
# CONFIG_DEV_NULL is not set
CONFIG_FS_PROCFS=y
CONFIG_FS_ROMFS=y
CONFIG_IRQCHAIN=y
CONFIG_MEMSET_OPTSPEED=y
CONFIG_NSH_ARCHROMFS=y
CONFIG_NSH_BUILTIN_APPS=y
CONFIG_NSH_LINELEN=128
CONFIG_NSH_PROMPT_STRING="ap> "
CONFIG_NSH_READLINE=y
CONFIG_NSH_ROMFSETC=y
CONFIG_ONESHOT_SONG=y
CONFIG_ONESHOT=y
CONFIG_RAW_BINARY=y
CONFIG_READLINE_CMD_HISTORY=y
CONFIG_READLINE_TABCOMPLETION=y
CONFIG_RV32IM_HW_MULDIV=y
CONFIG_SCHED_CHILD_STATUS=y
CONFIG_SCHED_HAVE_PARENT=y
CONFIG_SCHED_IRQMONITOR=y
CONFIG_SCHED_TICKLESS_ALARM=y
CONFIG_SCHED_TICKLESS_LIMIT_MAX_SLEEP=y
CONFIG_SCHED_TICKLESS=y
CONFIG_SCHED_WAITPID=y
CONFIG_SERIAL_TERMIOS=y
CONFIG_SERIAL_UART_ARCH_MMIO=y
CONFIG_SIG_DEFAULT=y
CONFIG_SONG_HIPRI_INTERRUPT=0xf
CONFIG_SONG_NR_IRQS=23
CONFIG_SYSLOG_BUFFER=y
CONFIG_SYSLOG_INTBUFFER=y
CONFIG_SYSLOG_PREFIX_STRING="ap: "
CONFIG_SYSLOG_PREFIX=y
CONFIG_SYSTEM_CLE=y
CONFIG_SYSTEM_NSH=y
CONFIG_SYSTEM_TIME64=y
CONFIG_SYSTEM_ZMODEM_MOUNTPOINT="/data"
CONFIG_SYSTEM_ZMODEM=y
CONFIG_TOOLS_COREMARK=y
CONFIG_TTY_SIGINT=y
CONFIG_U2_RI5CY=y
CONFIG_USER_ENTRYPOINT="nsh_main"
CONFIG_VINTC_DW_BASE=0xa0000000
```

## configs/v1/isp/defconfig
```kconfig
CONFIG_16550_ADDRWIDTH=32
CONFIG_16550_REGWIDTH=32
CONFIG_16550_SERIAL_DISABLE_REORDERING=y
CONFIG_16550_UART3_BASE=0xf900b000
CONFIG_16550_UART3_CLOCK=1843200
CONFIG_16550_UART3_IRQ=23
CONFIG_16550_UART3_RXBUFSIZE=512
CONFIG_16550_UART3_SERIAL_CONSOLE=y
CONFIG_16550_UART3=y
CONFIG_16550_UART=y
CONFIG_ALARM_ARCH=y
CONFIG_ARCH_BOARD="song/v1"
CONFIG_ARCH_BOARD_SONG=y
CONFIG_ARCH_BOARD_V1=y
CONFIG_ARCH_CHIP_SONG=y
CONFIG_ARCH_CHIP_V1_ISP=y
CONFIG_ARCH_HIPRI_INTERRUPT=y
CONFIG_ARCH="risc-v"
CONFIG_ARCH_RISCV_SONG=y
CONFIG_ARCH_RISCV=y
CONFIG_ARCH_STACKDUMP=y
CONFIG_BOOT_RUNFROMISRAM=y
CONFIG_BUILTIN=y
CONFIG_CLOCK_MONOTONIC=y
# CONFIG_DEV_NULL is not set
CONFIG_EXAMPLES_HELLO=y
CONFIG_FS_BINFS=y
CONFIG_FS_PROCFS=y
CONFIG_FS_ROMFS=y
CONFIG_FS_TMPFS=y
CONFIG_IRQCHAIN=y
CONFIG_MEMSET_OPTSPEED=y
CONFIG_NSH_ARCHINIT=y
CONFIG_NSH_ARCHROMFS=y
CONFIG_NSH_BUILTIN_APPS=y
CONFIG_NSH_DISABLE_UNAME=y
CONFIG_NSH_LINELEN=128
CONFIG_NSH_PROMPT_STRING="isp> "
CONFIG_NSH_READLINE=y
CONFIG_NSH_ROMFSETC=y
CONFIG_ONESHOT_SONG=y
CONFIG_ONESHOT=y
CONFIG_RAW_BINARY=y
CONFIG_READLINE_CMD_HISTORY=y
CONFIG_READLINE_TABCOMPLETION=y
CONFIG_RV32IM_HW_MULDIV=y
CONFIG_SCHED_CHILD_STATUS=y
CONFIG_SCHED_HAVE_PARENT=y
CONFIG_SCHED_IRQMONITOR=y
CONFIG_SCHED_TICKLESS_ALARM=y
CONFIG_SCHED_TICKLESS_LIMIT_MAX_SLEEP=y
CONFIG_SCHED_TICKLESS=y
CONFIG_SCHED_WAITPID=y
CONFIG_SERIAL_TERMIOS=y
CONFIG_SERIAL_UART_ARCH_MMIO=y
CONFIG_SIG_DEFAULT=y
CONFIG_SONG_HIPRI_INTERRUPT=0xf
CONFIG_SONG_NR_IRQS=30
CONFIG_SYSLOG_BUFFER=y
CONFIG_SYSLOG_INTBUFFER=y
CONFIG_SYSLOG_PREFIX_STRING="isp: "
CONFIG_SYSLOG_PREFIX=y
CONFIG_SYSLOG_TIMESTAMP=y
CONFIG_SYSTEM_CLE=y
CONFIG_SYSTEM_NSH=y
CONFIG_SYSTEM_TIME64=y
CONFIG_TTY_SIGINT=y
CONFIG_USER_ENTRYPOINT="nsh_main"
CONFIG_VINTC_DW_BASE=0xfa440000
```
