## configs/Kconfig
```kconfig
#
# For a description of the syntax of this configuration file,
# see the file kconfig-language.txt in the NuttX tools repository.
#

choice
	prompt "Select target board"
	default ARCH_BOARD_U1
	---help---
		Select the board hosting the architecture.  You must first select the
		exact MCU part number, then the boards supporting that part will
		be available for selection.  Use ARCH_BOARD_CUSTOM to create a new
		board configuration.

config ARCH_BOARD_ABIES
	bool "Pinecone Abies"
	---help---
		Pinecone Abies SoC.

config ARCH_BOARD_BANKS
	bool "Pinecone Banks"
	---help---
		Pinecone Banks SoC.

config ARCH_BOARD_U1
	bool "Pinecone U1"
	---help---
		Pinecone U1 MCU.

config ARCH_BOARD_U2
	bool "Pinecone U2"
	---help---
		Pinecone U2 MCU.

endchoice

if ARCH_BOARD_ABIES
source "configs/song/abies/Kconfig"
endif
if ARCH_BOARD_BANKS
source "configs/song/banks/Kconfig"
endif
if ARCH_BOARD_U1
source "configs/song/u1/Kconfig"
endif
if ARCH_BOARD_U2
source "configs/song/u2/Kconfig"
endif
```

## configs/banks/audio/defconfig
```kconfig
CONFIG_ALARM_ARCH=y
CONFIG_ARCH_BOARD_BANKS=y
CONFIG_ARCH_BOARD="song/banks"
CONFIG_ARCH_BOARD_SONG=y
CONFIG_ARCH="ceva"
CONFIG_ARCH_CEVA=y
CONFIG_ARCH_CHIP_BANKS_ADSP=y
CONFIG_ARCH_CHIP_SONG=y
CONFIG_ARCH_DCACHE=y
CONFIG_ARCH_DEFAULT_HEAP=1
CONFIG_ARCH_DTCM_SIZE=262144
CONFIG_ARCH_HARDFAULT_IRQ=4
CONFIG_ARCH_ICACHE=y
CONFIG_ARCH_ITCM_SIZE=262144
CONFIG_ARCH_MPU=y
CONFIG_ARCH_NR_MEMORY=2
CONFIG_ARCH_RTL_MAJOR=3
CONFIG_ARCH_RTL_MINOR=0
CONFIG_ARCH_RTL_REVISION=0
CONFIG_ARCH_STACKDUMP=y
CONFIG_ARCH_TL4_VOICE=y
CONFIG_AUDIO_COMP=y
CONFIG_AUDIO_DMA=y
CONFIG_AUDIO_I2S=y
CONFIG_AUDIO=y
CONFIG_BOARDCTL_FINALINIT=y
CONFIG_BOOT_RUNFROMISRAM=y
CONFIG_BUILTIN=y
CONFIG_CLK_RPMSG=y
CONFIG_CLK=y
CONFIG_CLOCK_MONOTONIC=y
CONFIG_DEBUG_HARDFAULT=y
CONFIG_DMA=y
CONFIG_DRIVERS_AUDIO=y
CONFIG_FS_HOSTFS_RPMSG=y
CONFIG_FS_HOSTFS=y
# CONFIG_FS_PROCFS_EXCLUDE_ENVIRON is not set
CONFIG_FS_PROCFS=y
CONFIG_FS_ROMFS=y
CONFIG_HEAP_COLORATION=y
CONFIG_HOSTNAME="audio"
CONFIG_I2S=y
CONFIG_IDLETHREAD_STACKSIZE=2048
CONFIG_IRQCHAIN=y
CONFIG_MBOX=y
CONFIG_NSH_ARCHINIT=y
CONFIG_NSH_ARCHROMFS=y
CONFIG_NSH_BUILTIN_APPS=y
CONFIG_NSH_LINELEN=128
CONFIG_NSH_PROMPT_STRING="audio> "
CONFIG_NSH_READLINE=y
CONFIG_NSH_ROMFSETC=y
CONFIG_ONESHOT_SONG=y
CONFIG_ONESHOT=y
CONFIG_OPENAMP=y
CONFIG_PM=y
CONFIG_PSEUDOFS_SOFTLINKS=y
CONFIG_PSEUDOTERM_BSD=y
CONFIG_PSEUDOTERM=y
CONFIG_PTHREAD_CLEANUP_STACKSIZE=2
CONFIG_PTHREAD_CLEANUP=y
CONFIG_READLINE_CMD_HISTORY=y
CONFIG_READLINE_TABCOMPLETION=y
CONFIG_RPMSG_UART=y
CONFIG_RPTUN=y
CONFIG_RTC_ALARM=y
CONFIG_RTC_ARCH=y
CONFIG_RTC_DATETIME=y
CONFIG_RTC_DRIVER=y
CONFIG_RTC_EXTERNAL=y
CONFIG_RTC_RPMSG=y
CONFIG_RTC=y
CONFIG_SCHED_CHILD_STATUS=y
CONFIG_SCHED_HAVE_PARENT=y
CONFIG_SCHED_HPWORK=y
CONFIG_SCHED_IRQMONITOR=y
CONFIG_SCHED_TICKLESS_ALARM=y
CONFIG_SCHED_TICKLESS_LIMIT_MAX_SLEEP=y
CONFIG_SCHED_TICKLESS=y
CONFIG_SERIAL_IFLOWCONTROL_WATERMARKS=y
CONFIG_SERIAL_TERMIOS=y
CONFIG_SIG_DEFAULT=y
CONFIG_SIG_EVTHREAD=y
CONFIG_SONG_DMAS=y
CONFIG_SONG_MBOX=y
CONFIG_SONG_NR_IRQS=30
CONFIG_SONG_PCM=y
CONFIG_SONG_RPTUN=y
CONFIG_STACK_COLORATION=y
CONFIG_SYSLOG_BUFFER=y
CONFIG_SYSLOG_CHARDEV=y
CONFIG_SYSLOG_PREFIX_STRING="audio: "
CONFIG_SYSLOG_PREFIX=y
CONFIG_SYSLOG_RPMSG=y
CONFIG_SYSLOG_TIMESTAMP=y
CONFIG_SYSTEM_CLE=y
CONFIG_SYSTEM_NSH=y
CONFIG_SYSTEM_NXPLAYER=y
CONFIG_SYSTEM_NXRECORDER=y
CONFIG_SYSTEM_SYSTEM=y
CONFIG_SYSTEM_TIME64=y
CONFIG_TTY_SIGINT=y
CONFIG_USER_ENTRYPOINT="nsh_main"
CONFIG_VINTC_DW_BASE=0xf810c000
CONFIG_VINTC_DW=y
CONFIG_WATCHDOG_DW=y
CONFIG_WATCHDOG=y
```

## configs/banks/cp/defconfig
```kconfig
CONFIG_ARCH="arm"
CONFIG_ARCH_ARM_SONG=y
CONFIG_ARCH_BOARD_BANKS=y
CONFIG_ARCH_BOARD="song/banks"
CONFIG_ARCH_BOARD_SONG=y
CONFIG_ARCH_CHIP_BANKS_CP=y
CONFIG_ARCH_CHIP_SONG=y
CONFIG_ARCH_LOWVECTORS=y
CONFIG_ARCH_STACKDUMP=y
CONFIG_ARCH_TRUSTZONE_NONSECURE=y
CONFIG_ARM_SEMIHOSTING_HOSTFS=y
CONFIG_BANKS_CP=y
CONFIG_BOARDCTL_FINALINIT=y
CONFIG_BOOT_RUNFROMSDRAM=y
CONFIG_BUILTIN=y
CONFIG_CLK=y
CONFIG_CLOCK_MONOTONIC=y
CONFIG_DEBUG_SYMBOLS=y
CONFIG_DMA=y
CONFIG_EXPERIMENTAL=y
CONFIG_FS_HOSTFS_RPMSG=y
CONFIG_FS_HOSTFS=y
# CONFIG_FS_PROCFS_EXCLUDE_ENVIRON is not set
CONFIG_FS_PROCFS=y
CONFIG_FS_ROMFS=y
CONFIG_IDLETHREAD_STACKSIZE=2048
CONFIG_IRQCHAIN=y
CONFIG_LIB_HOSTNAME="cp"
CONFIG_MBOX=y
CONFIG_MEMSET_OPTSPEED=y
CONFIG_NETUTILS_CODECS=y
CONFIG_NSH_ARCHINIT=y
CONFIG_NSH_ARCHROMFS=y
CONFIG_NSH_BUILTIN_APPS=y
CONFIG_NSH_LINELEN=128
CONFIG_NSH_PROMPT_STRING="cp> "
CONFIG_NSH_READLINE=y
CONFIG_NSH_ROMFSETC=y
CONFIG_OPENAMP=y
CONFIG_PSEUDOFS_SOFTLINKS=y
CONFIG_PSEUDOTERM_BSD=y
CONFIG_PSEUDOTERM=y
CONFIG_PTHREAD_CLEANUP_STACKSIZE=2
CONFIG_PTHREAD_CLEANUP=y
CONFIG_PTHREAD_MUTEX_TYPES=y
CONFIG_RAM_SIZE=2147483648
CONFIG_RAW_BINARY=y
CONFIG_READLINE_CMD_HISTORY=y
CONFIG_READLINE_TABCOMPLETION=y
CONFIG_RPMSG_UART=y
CONFIG_RPTUN=y
CONFIG_SCHED_CHILD_STATUS=y
CONFIG_SCHED_HAVE_PARENT=y
CONFIG_SCHED_HPWORK=y
CONFIG_SCHED_IRQMONITOR=y
CONFIG_SCHED_LPWORK=y
CONFIG_SERIAL_TERMIOS=y
CONFIG_SIG_DEFAULT=y
CONFIG_SIG_EVTHREAD=y
CONFIG_SIMPLE_ADDRENV=y
CONFIG_SONG_CLK=y
CONFIG_SONG_DMAG=y
CONFIG_SONG_DMAS=y
CONFIG_SONG_GIC_VBASE=0x80020000
CONFIG_SONG_MBOX=y
CONFIG_SONG_NR_IRQS=64
CONFIG_SONG_PGTABLE_START=0x6400000
CONFIG_SONG_RPTUN=y
CONFIG_STACK_COLORATION=y
CONFIG_SYSLOG_BUFFER=y
CONFIG_SYSLOG_CHARDEV=y
CONFIG_SYSLOG_PREFIX_STRING="cp: "
CONFIG_SYSLOG_PREFIX=y
CONFIG_SYSLOG_RPMSG=y
CONFIG_SYSLOG_TIMESTAMP=y
CONFIG_SYSTEM_CLE=y
CONFIG_SYSTEM_NSH=y
CONFIG_SYSTEM_SYSTEM=y
CONFIG_SYSTEM_TIME64=y
CONFIG_TIMER_ARCH=y
CONFIG_TIMER_DW=y
CONFIG_TIMER=y
CONFIG_TTY_SIGINT=y
CONFIG_USER_ENTRYPOINT="nsh_main"
```

## configs/banks/sensor/defconfig
```kconfig
CONFIG_ALARM_ARCH=y
CONFIG_ARCH="arm"
CONFIG_ARCH_ARM_SONG=y
CONFIG_ARCH_BOARD_BANKS=y
CONFIG_ARCH_BOARD="song/banks"
CONFIG_ARCH_BOARD_SONG=y
CONFIG_ARCH_CHIP_BANKS_SENSOR=y
CONFIG_ARCH_CHIP_SONG=y
CONFIG_ARCH_RAMVECTORS=y
CONFIG_ARCH_STACKDUMP=y
CONFIG_ARM_MPU=y
CONFIG_ARMV7M_MEMCPY=y
CONFIG_ARMV7M_SYSTICK=y
CONFIG_ARMV7M_USEBASEPRI=y
CONFIG_AUDIO_COMP=y
CONFIG_AUDIO_DMA=y
CONFIG_AUDIO_I2S=y
CONFIG_AUDIO=y
CONFIG_BANKS_SENSOR=y
CONFIG_BOARDCTL_FINALINIT=y
CONFIG_BOOT_RUNFROMISRAM=y
CONFIG_BUILTIN=y
CONFIG_CLK_RPMSG=y
CONFIG_CLK=y
CONFIG_CLOCK_MONOTONIC=y
CONFIG_DEBUG_ASSERTIONS=y
CONFIG_DEBUG_ERROR=y
CONFIG_DEBUG_FULLOPT=y
CONFIG_DEBUG_HARDFAULT_ALERT=y
CONFIG_DEBUG_INFO=y
CONFIG_DEBUG_MEMFAULT=y
CONFIG_DEBUG_SPI_ERROR=y
CONFIG_DEBUG_SPI_INFO=y
CONFIG_DEBUG_SPI_WARN=y
CONFIG_DEBUG_SPI=y
CONFIG_DEBUG_SYMBOLS=y
CONFIG_DEBUG_WARN=y
# CONFIG_DEV_NULL is not set
CONFIG_DMA=y
CONFIG_DRIVERS_AUDIO=y
CONFIG_FS_HOSTFS_RPMSG=y
CONFIG_FS_HOSTFS=y
CONFIG_FS_PROCFS=y
CONFIG_FS_ROMFS=y
CONFIG_HEAP_COLORATION=y
CONFIG_I2S=y
CONFIG_IOEXPANDER_MULTIPIN=y
CONFIG_IOEXPANDER_NPINS=256
CONFIG_IOEXPANDER=y
CONFIG_IRQCHAIN=y
CONFIG_MBOX=y
CONFIG_MEMSET_OPTSPEED=y
CONFIG_NETDB_DNSCLIENT_MAXRESPONSE=176
CONFIG_NETDB_DNSCLIENT=y
CONFIG_NETDB_DNSSERVER_IPv4ADDR=0x771d1d1d
# CONFIG_NET_ETHERNET is not set
CONFIG_NET_SOCKOPTS=y
CONFIG_NET_USRSOCK_OTHER=y
CONFIG_NET_USRSOCK_TCP=y
CONFIG_NET_USRSOCK_UDP=y
CONFIG_NET_USRSOCK=y
CONFIG_NET=y
CONFIG_NSH_ARCHINIT=y
CONFIG_NSH_ARCHROMFS=y
CONFIG_NSH_BUILTIN_APPS=y
CONFIG_NSH_LINELEN=128
# CONFIG_NSH_NETINIT is not set
CONFIG_NSH_PROMPT_STRING="sensor> "
CONFIG_NSH_READLINE=y
CONFIG_NSH_ROMFSETC=y
CONFIG_ONESHOT_SONG=y
CONFIG_ONESHOT=y
CONFIG_OPENAMP=y
CONFIG_PM=y
CONFIG_RAW_BINARY=y
CONFIG_READLINE_CMD_HISTORY=y
CONFIG_READLINE_TABCOMPLETION=y
CONFIG_RPMSG_UART=y
CONFIG_RPMSG_USRSOCK=y
CONFIG_RPTUN=y
CONFIG_RTC_ARCH=y
CONFIG_RTC_DATETIME=y
CONFIG_RTC_DRIVER=y
CONFIG_RTC_EXTERNAL=y
CONFIG_RTC_RPMSG=y
CONFIG_RTC=y
CONFIG_SCHED_CHILD_STATUS=y
CONFIG_SCHED_HAVE_PARENT=y
CONFIG_SCHED_HPWORK=y
CONFIG_SCHED_IRQMONITOR=y
CONFIG_SCHED_TICKLESS_ALARM=y
CONFIG_SCHED_TICKLESS_LIMIT_MAX_SLEEP=y
CONFIG_SCHED_TICKLESS=y
CONFIG_SCHED_WAITPID=y
CONFIG_SERIAL_IFLOWCONTROL_WATERMARKS=y
CONFIG_SERIAL_TERMIOS=y
CONFIG_SIG_DEFAULT=y
CONFIG_SONG_CLK=y
CONFIG_SONG_DMAS=y
CONFIG_SONG_I2S=y
CONFIG_SONG_IOE=y
CONFIG_SONG_MBOX=y
CONFIG_SONG_NR_IRQS=49
CONFIG_SONG_PDM=y
CONFIG_SONG_RPTUN=y
CONFIG_SPI_DRIVER=y
CONFIG_SPI_DW=y
CONFIG_SPI=y
CONFIG_STACK_COLORATION=y
CONFIG_SYSLOG_PREFIX_STRING="sensor: "
CONFIG_SYSLOG_PREFIX=y
CONFIG_SYSLOG_RPMSG=y
CONFIG_SYSLOG_TIMESTAMP=y
CONFIG_SYSTEM_CLE=y
CONFIG_SYSTEM_NSH=y
CONFIG_SYSTEM_NXPLAYER=y
CONFIG_SYSTEM_NXRECORDER=y
CONFIG_SYSTEM_PING=y
CONFIG_SYSTEM_TIME64=y
CONFIG_TIMER=y
CONFIG_TTY_SIGINT=y
CONFIG_USER_ENTRYPOINT="nsh_main"
CONFIG_WATCHDOG_DW=y
CONFIG_WATCHDOG=y
```

## configs/u1/ap/defconfig
```kconfig
CONFIG_ARCH="arm"
CONFIG_ARCH_ARM_SONG=y
CONFIG_ARCH_BOARD="song/u1"
CONFIG_ARCH_BOARD_SONG=y
CONFIG_ARCH_CHIP_SONG=y
CONFIG_ARCH_CHIP_U1_AP=y
CONFIG_ARCH_RAMVECTORS=y
CONFIG_ARCH_STACKDUMP=y
CONFIG_ARM_MPU=y
CONFIG_ARMV7M_MEMCPY=y
CONFIG_ARMV7M_SYSTICK=y
CONFIG_ARMV7M_USEBASEPRI=y
CONFIG_BOARDCTL_FINALINIT=y
CONFIG_BOARDCTL_RESET=y
CONFIG_BOARD_RESET_ON_ASSERT=y
CONFIG_BUILTIN=y
CONFIG_CLK_RPMSG=y
CONFIG_CLK=y
CONFIG_CLOCK_MONOTONIC=y
CONFIG_DEBUG_FEATURES=y
CONFIG_DEBUG_FULLOPT=y
CONFIG_DEBUG_HARDFAULT=y
CONFIG_DEBUG_SYMBOLS=y
# CONFIG_DEV_NULL is not set
CONFIG_DMA=y
CONFIG_EXAMPLES_NSH=y
CONFIG_FS_HOSTFS_RPMSG=y
CONFIG_FS_HOSTFS=y
CONFIG_FS_PROCFS=y
CONFIG_FS_ROMFS=y
CONFIG_HEAP_COLORATION=y
CONFIG_I2C_DRIVER=y
CONFIG_I2C_DW=y
CONFIG_I2C=y
CONFIG_IOEXPANDER_MULTIPIN=y
CONFIG_IOEXPANDER_NPINS=48
CONFIG_IOEXPANDER=y
CONFIG_IRQCHAIN=y
CONFIG_MBOX=y
CONFIG_MEMSET_OPTSPEED=y
CONFIG_NETDB_DNSCLIENT_MAXRESPONSE=176
CONFIG_NETDB_DNSCLIENT=y
CONFIG_NETDB_DNSSERVER_IPv4ADDR=0x771d1d1d
# CONFIG_NET_ETHERNET is not set
CONFIG_NET_SOCKOPTS=y
CONFIG_NET_USRSOCK_OTHER=y
CONFIG_NET_USRSOCK_TCP=y
CONFIG_NET_USRSOCK_UDP=y
CONFIG_NET_USRSOCK=y
CONFIG_NET=y
CONFIG_NSH_ARCHINIT=y
CONFIG_NSH_ARCHROMFS=y
CONFIG_NSH_BUILTIN_APPS=y
CONFIG_NSH_LINELEN=128
# CONFIG_NSH_NETINIT is not set
CONFIG_NSH_PROMPT_STRING="ap> "
CONFIG_NSH_READLINE=y
CONFIG_NSH_ROMFSETC=y
CONFIG_ONESHOT_SONG=y
CONFIG_ONESHOT=y
CONFIG_OPENAMP=y
CONFIG_PM=y
CONFIG_RAW_BINARY=y
CONFIG_READLINE_CMD_HISTORY=y
CONFIG_READLINE_TABCOMPLETION=y
CONFIG_RPMSG_REGULATOR_CLIENT=y
CONFIG_RPMSG_REGULATOR=y
CONFIG_RPMSG_UART=y
CONFIG_RPMSG_USRSOCK=y
CONFIG_RPTUN=y
CONFIG_RTC_ALARM=y
CONFIG_RTC_ARCH=y
CONFIG_RTC_DATETIME=y
CONFIG_RTC_DRIVER=y
CONFIG_RTC_SONG=y
CONFIG_RTC=y
CONFIG_SCHED_CHILD_STATUS=y
CONFIG_SCHED_HAVE_PARENT=y
CONFIG_SCHED_HPWORK=y
CONFIG_SCHED_IRQMONITOR=y
CONFIG_SCHED_TICKLESS_LIMIT_MAX_SLEEP=y
CONFIG_SCHED_TICKLESS=y
CONFIG_SCHED_WAITPID=y
CONFIG_SERIAL_IFLOWCONTROL_WATERMARKS=y
CONFIG_SIG_SIGKILL=y
CONFIG_SONG_DMAS=y
CONFIG_SONG_ICACHE_BASE=0xb0030050
CONFIG_SONG_IOE=y
CONFIG_SONG_MBOX=y
CONFIG_SONG_NR_IRQS=33
CONFIG_SONG_RPTUN=y
CONFIG_STACK_COLORATION=y
CONFIG_SYSLOG_PREFIX_STRING="ap: "
CONFIG_SYSLOG_PREFIX=y
CONFIG_SYSLOG_RPMSG=y
CONFIG_SYSLOG_TIMESTAMP=y
CONFIG_SYSTEM_CLE=y
CONFIG_SYSTEM_PING=y
CONFIG_SYSTEM_TIME64=y
CONFIG_TIMER_ARCH=y
CONFIG_TIMER=y
CONFIG_USER_ENTRYPOINT="nsh_main"
CONFIG_WATCHDOG_DW=y
CONFIG_WATCHDOG=y
```

## configs/u1/cp/defconfig
```kconfig
CONFIG_16550_ADDRWIDTH=32
CONFIG_16550_REGWIDTH=32
CONFIG_16550_SERIAL_DISABLE_REORDERING=y
CONFIG_16550_UART2_BASE=0xb00c0000
CONFIG_16550_UART2_BAUD=3000000
CONFIG_16550_UART2_CLOCK=48000000
CONFIG_16550_UART2_CLOCK_NAME="sp/uart2_clk"
CONFIG_16550_UART2_DMA_TX=2
CONFIG_16550_UART2_DMA=y
CONFIG_16550_UART2_IRQ=23
CONFIG_16550_UART2=y
CONFIG_16550_UART=y
CONFIG_ALARM_ARCH=y
CONFIG_ARCH="arm"
CONFIG_ARCH_ARM_SONG=y
CONFIG_ARCH_BOARD="song/u1"
CONFIG_ARCH_BOARD_SONG=y
CONFIG_ARCH_BOARD_U1=y
CONFIG_ARCH_CHIP_SONG=y
CONFIG_ARCH_CHIP_U1_CP=y
CONFIG_ARCH_HIPRI_INTERRUPT=y
CONFIG_ARCH_RAMVECTORS=y
CONFIG_ARCH_STACKDUMP=y
CONFIG_ARM_MPU=y
CONFIG_ARMV7M_MEMCPY=y
CONFIG_ARMV7M_SYSTICK=y
CONFIG_BOARD_CRASHDUMP=y
CONFIG_BOARDCTL_FINALINIT=y
CONFIG_BOARDCTL_RESET=y
CONFIG_BOARD_RESET_ON_ASSERT=2
CONFIG_BUILTIN=y
CONFIG_CLK_RPMSG=y
CONFIG_CLK=y
CONFIG_CLOCK_MONOTONIC=y
CONFIG_CMSIS=y
CONFIG_CODECS_HASH_MD5=y
CONFIG_DEBUG_FULLOPT=y
CONFIG_DEBUG_HARDFAULT_ALERT=y
CONFIG_DEBUG_MEMFAULT=y
CONFIG_DEBUG_SYMBOLS=y
CONFIG_DMA=y
CONFIG_EARLY_STACKSIZE=512
CONFIG_FS_HOSTFS_RPMSG=y
CONFIG_FS_HOSTFS=y
# CONFIG_FS_PROCFS_EXCLUDE_ENVIRON is not set
CONFIG_FS_PROCFS=y
CONFIG_FS_ROMFS=y
CONFIG_IDLETHREAD_STACKSIZE=2048
CONFIG_IOEXPANDER_MULTIPIN=y
CONFIG_IOEXPANDER_NPINS=48
CONFIG_IOEXPANDER=y
CONFIG_IRQCHAIN=y
CONFIG_LIBC_IPv4_ADDRCONV=y
CONFIG_LIBC_IPv6_ADDRCONV=y
CONFIG_LIB_HOSTNAME="cp"
CONFIG_MBOX=y
CONFIG_MEMSET_OPTSPEED=y
CONFIG_MM_REGIONS=2
CONFIG_NBIOT_MODEM=y
CONFIG_NETUTILS_CODECS=y
CONFIG_NSH_ARCHINIT=y
CONFIG_NSH_ARCHROMFS=y
CONFIG_NSH_BUILTIN_APPS=y
CONFIG_NSH_LINELEN=128
CONFIG_NSH_PROMPT_STRING="cp> "
CONFIG_NSH_READLINE=y
CONFIG_NSH_ROMFSETC=y
CONFIG_ONESHOT_SONG=y
CONFIG_ONESHOT=y
CONFIG_OPENAMP=y
CONFIG_PM_IDLEENTER_COUNT=0
CONFIG_PM_SLEEPENTER_COUNT=600000
CONFIG_PM_SLICEMS=1
CONFIG_PM_STANDBYENTER_COUNT=0
CONFIG_PM=y
CONFIG_PSEUDOFS_SOFTLINKS=y
CONFIG_PSEUDOTERM_BSD=y
CONFIG_PSEUDOTERM=y
CONFIG_PTHREAD_CLEANUP_STACKSIZE=2
CONFIG_PTHREAD_CLEANUP=y
CONFIG_PTHREAD_MUTEX_TYPES=y
CONFIG_RAW_BINARY=y
CONFIG_READLINE_CMD_HISTORY=y
CONFIG_READLINE_TABCOMPLETION=y
CONFIG_RPMSG_REGULATOR_CLIENT=y
CONFIG_RPMSG_REGULATOR=y
CONFIG_RPMSG_UART=y
CONFIG_RPTUN=y
CONFIG_RTC_ALARM=y
CONFIG_RTC_ARCH=y
CONFIG_RTC_DATETIME=y
CONFIG_RTC_DRIVER=y
CONFIG_RTC_EXTERNAL=y
CONFIG_RTC_SONG=y
CONFIG_RTC=y
CONFIG_RTSS_BUF_SIZE=32768
CONFIG_SCHED_CHILD_STATUS=y
CONFIG_SCHED_HAVE_PARENT=y
CONFIG_SCHED_HPWORK=y
CONFIG_SCHED_INSTRUMENTATION_BUFFER=y
CONFIG_SCHED_INSTRUMENTATION=y
CONFIG_SCHED_IRQMONITOR=y
CONFIG_SCHED_LPWORK=y
CONFIG_SCHED_TICKLESS_ALARM=y
CONFIG_SCHED_TICKLESS_LIMIT_MAX_SLEEP=y
CONFIG_SCHED_TICKLESS=y
CONFIG_SERIAL_IFLOWCONTROL_WATERMARKS=y
CONFIG_SERIAL_TERMIOS=y
CONFIG_SERIAL_UART_ARCH_MMIO=y
CONFIG_SIG_DEFAULT=y
CONFIG_SIG_EVTHREAD=y
CONFIG_SIMPLE_ADDRENV=y
CONFIG_SONG_CLK=y
CONFIG_SONG_DMAS=y
CONFIG_SONG_ICACHE_BASE=0xb0030040
CONFIG_SONG_IOE=y
CONFIG_SONG_MBOX=y
CONFIG_SONG_NR_IRQS=44
CONFIG_SONG_RPTUN=y
CONFIG_STACK_COLORATION=y
CONFIG_SYSLOG_BUFFER=y
CONFIG_SYSLOG_CHARDEV=y
CONFIG_SYSLOG_PREFIX_STRING="cp: "
CONFIG_SYSLOG_PREFIX=y
CONFIG_SYSLOG_RPMSG=y
CONFIG_SYSLOG_TIMESTAMP=y
CONFIG_SYSTEM_CLE=y
CONFIG_SYSTEM_NSH=y
CONFIG_SYSTEM_SYSTEM=y
CONFIG_SYSTEM_TIME64=y
CONFIG_TIMER=y
CONFIG_TTY_SIGINT=y
CONFIG_U1_CP=y
CONFIG_USER_ENTRYPOINT="nsh_main"
CONFIG_WATCHDOG_AUTOMONITOR_BY_IDLE=y
CONFIG_WATCHDOG_AUTOMONITOR=y
CONFIG_WATCHDOG_DW=y
CONFIG_WATCHDOG=y
```
